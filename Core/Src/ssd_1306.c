#include "ssd_1306.h"

// The 1,024 byte memory buffer that represents the screen
static uint8_t SSD1306_Buffer[SSD1306_BUFFER_SIZE];

// Trackers for text cursor
static uint8_t CurrentX = 0;
static uint8_t CurrentY = 0;

// Standard 5x7 ASCII Font Array (Characters 32 to 126)
static const uint8_t Font5x7[][5] = {
    {0x00, 0x00, 0x00, 0x00, 0x00}, {0x00, 0x00, 0x5F, 0x00, 0x00}, {0x00, 0x07, 0x00, 0x07, 0x00},
    {0x14, 0x7F, 0x14, 0x7F, 0x14}, {0x24, 0x2A, 0x7F, 0x2A, 0x12}, {0x23, 0x13, 0x08, 0x64, 0x62},
    {0x36, 0x49, 0x55, 0x22, 0x50}, {0x00, 0x05, 0x03, 0x00, 0x00}, {0x00, 0x1C, 0x22, 0x41, 0x00},
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    {0x00, 0x41, 0x36, 0x08, 0x00}, {0x08, 0x08, 0x2A, 0x1C, 0x08}, {0x08, 0x1C, 0x2A, 0x08, 0x08}
};

/* --- LOW LEVEL HARDWARE CONTROL --- */

static void SSD1306_WriteCommand(uint8_t command) {
    HAL_GPIO_WritePin(OLED_CS_PORT, OLED_CS_PIN, GPIO_PIN_RESET); // Select Chip
    HAL_GPIO_WritePin(OLED_DC_PORT, OLED_DC_PIN, GPIO_PIN_RESET); // Data/Command = 0 (Command)
    HAL_SPI_Transmit(&hspi1, &command, 1, 10);
    HAL_GPIO_WritePin(OLED_CS_PORT, OLED_CS_PIN, GPIO_PIN_SET);   // Deselect Chip
}

static void SSD1306_WriteData(uint8_t* data, uint16_t size) {
    HAL_GPIO_WritePin(OLED_CS_PORT, OLED_CS_PIN, GPIO_PIN_RESET); // Select Chip
    HAL_GPIO_WritePin(OLED_DC_PORT, OLED_DC_PIN, GPIO_PIN_SET);   // Data/Command = 1 (Data)
    HAL_SPI_Transmit(&hspi1, data, size, 100);
    HAL_GPIO_WritePin(OLED_CS_PORT, OLED_CS_PIN, GPIO_PIN_SET);   // Deselect Chip
}

/* --- MAIN FUNCTIONS --- */

void SSD1306_Init(void) {
    // 1. Hardware Reset
    HAL_GPIO_WritePin(OLED_RES_PORT, OLED_RES_PIN, GPIO_PIN_SET);
    HAL_Delay(10);
    HAL_GPIO_WritePin(OLED_RES_PORT, OLED_RES_PIN, GPIO_PIN_RESET);
    HAL_Delay(10);
    HAL_GPIO_WritePin(OLED_RES_PORT, OLED_RES_PIN, GPIO_PIN_SET);
    HAL_Delay(100);

    // 2. Initialization Sequence
    SSD1306_WriteCommand(0xAE); // Display OFF
    SSD1306_WriteCommand(0x20); // Set Memory Addressing Mode
    SSD1306_WriteCommand(0x00); // Horizontal Addressing Mode
    SSD1306_WriteCommand(0xB0); // Set Page Start Address for Page Addressing Mode
    SSD1306_WriteCommand(0xC0); // Set COM Output Scan Direction
    SSD1306_WriteCommand(0x00); // Set low column address
    SSD1306_WriteCommand(0x10); // Set high column address
    SSD1306_WriteCommand(0x40); // Set start line address
    SSD1306_WriteCommand(0x81); // Set contrast control register
    SSD1306_WriteCommand(0xFF);
    SSD1306_WriteCommand(0xA1); // Set segment re-map
    SSD1306_WriteCommand(0xA7); // Set normal display
    SSD1306_WriteCommand(0xA8); // Set multiplex ratio
    SSD1306_WriteCommand(0x3F);
    SSD1306_WriteCommand(0xA4); // Output follows RAM content
    SSD1306_WriteCommand(0xD3); // Set display offset
    SSD1306_WriteCommand(0x00); // No offset
    SSD1306_WriteCommand(0xD5); // Set display clock divide ratio/oscillator frequency
    SSD1306_WriteCommand(0xF0);
    SSD1306_WriteCommand(0xD9); // Set pre-charge period
    SSD1306_WriteCommand(0x22);
    SSD1306_WriteCommand(0xDA); // Set com pins hardware configuration
    SSD1306_WriteCommand(0x12);
    SSD1306_WriteCommand(0xDB); // Set vcomh
    SSD1306_WriteCommand(0x20);
    SSD1306_WriteCommand(0x8D); // Set Charge Pump
    SSD1306_WriteCommand(0x14);
    SSD1306_WriteCommand(0xAF); // Display ON

    // 3. Clear the screen memory and push it
    SSD1306_Clear();
    SSD1306_UpdateScreen();
}

void SSD1306_UpdateScreen(void) {
    // Tell the screen we are sending data from Column 0-127, Page 0-7
    SSD1306_WriteCommand(0x21);
    SSD1306_WriteCommand(0);
    SSD1306_WriteCommand(SSD1306_WIDTH - 1);

    SSD1306_WriteCommand(0x22);
    SSD1306_WriteCommand(0);
    SSD1306_WriteCommand(7);

    // Blast the entire 1024-byte RAM buffer over SPI!
    SSD1306_WriteData(SSD1306_Buffer, SSD1306_BUFFER_SIZE);
}

void SSD1306_Clear(void) {
    memset(SSD1306_Buffer, 0x00, SSD1306_BUFFER_SIZE);
}

void SSD1306_DrawPixel(uint8_t x, uint8_t y, SSD1306_Color_t color) {
    if(x >= SSD1306_WIDTH || y >= SSD1306_HEIGHT) return; // Prevent buffer overflow

    if(color == SSD1306_COLOR_WHITE) {
        SSD1306_Buffer[x + (y / 8) * SSD1306_WIDTH] |= (1 << (y % 8));
    } else {
        SSD1306_Buffer[x + (y / 8) * SSD1306_WIDTH] &= ~(1 << (y % 8));
    }
}

/* --- TEXT FUNCTIONS --- */

void SSD1306_SetCursor(uint8_t x, uint8_t y) {
    CurrentX = x;
    CurrentY = y;
}

void SSD1306_WriteChar(char ch, SSD1306_Color_t color) {
    // Check if character is valid ASCII
    if (ch < 32 || ch > 126) return;

    // Ensure we don't write off the edge of the screen
    if (SSD1306_WIDTH <= (CurrentX + 5) || SSD1306_HEIGHT <= (CurrentY + 7)) {
        return;
    }

    // Draw the 5 columns of the character
    for (uint8_t i = 0; i < 5; i++) {
        uint8_t b = Font5x7[ch - 32][i];
        for (uint8_t j = 0; j < 7; j++) {
            if ((b << j) & 0x40) {
                SSD1306_DrawPixel(CurrentX + i, CurrentY + j, color);
            } else {
                SSD1306_DrawPixel(CurrentX + i, CurrentY + j, !color);
            }
        }
    }
    // Advance cursor to the right (5 pixels wide + 1 pixel gap)
    CurrentX += 6;
}

void SSD1306_WriteString(char* str, SSD1306_Color_t color) {
    while (*str) {
        SSD1306_WriteChar(*str, color);
        str++;
    }
}
